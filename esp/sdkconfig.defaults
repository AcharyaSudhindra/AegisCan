## esp/sdkconfig.defaults
```kconfig
# ==============================================================================
# Aegis-CPS ESP32-S3 N16R8 — sdkconfig.defaults
# ==============================================================================

# --- Target ---
CONFIG_IDF_TARGET="esp32s3"

# --- Flash (16MB) ---
CONFIG_ESPTOOLPY_FLASHSIZE_16MB=y
CONFIG_ESPTOOLPY_FLASHMODE_DIO=y
CONFIG_ESPTOOLPY_FLASHFREQ_80M=y

# --- Custom Partition Table ---
CONFIG_PARTITION_TABLE_CUSTOM=y
CONFIG_PARTITION_TABLE_CUSTOM_FILENAME="partitions.csv"

# --- PSRAM (8MB Octal SPI) ---
CONFIG_SPIRAM=y
CONFIG_SPIRAM_MODE_OCT=y
CONFIG_SPIRAM_SPEED_80M=y
CONFIG_SPIRAM_BOOT_INIT=y
CONFIG_SPIRAM_USE_MALLOC=y
CONFIG_SPIRAM_MALLOC_ALWAYSINTERNAL=4096

# --- FreeRTOS ---
CONFIG_FREERTOS_HZ=1000
CONFIG_FREERTOS_UNICORE=n
CONFIG_FREERTOS_NUMBER_OF_CORES=2
CONFIG_FREERTOS_TIMER_TASK_STACK_DEPTH=4096

# --- SPI Slave (for FPGA interface) ---
CONFIG_SPI_SLAVE_ISR_IN_IRAM=y

# --- Hardware AES Acceleration ---
CONFIG_MBEDTLS_HARDWARE_AES=y
CONFIG_MBEDTLS_HARDWARE_GCM=y
CONFIG_MBEDTLS_AES_USE_INTERRUPT=y

# --- TLS 1.3 ---
CONFIG_MBEDTLS_SSL_PROTO_TLS1_3=y
CONFIG_MBEDTLS_SSL_TLS1_3_COMPATIBILITY_MODE=y

# --- LittleFS ---
CONFIG_LITTLEFS_MAX_PARTITIONS=3

# --- Wi-Fi ---
CONFIG_ESP_WIFI_SSID="Aegis_AP"
CONFIG_ESP_WIFI_PASSWORD=""
CONFIG_ESP_WIFI_MODE_STA=y

# --- MQTT ---
CONFIG_MQTT_PROTOCOL_5=y
CONFIG_MQTT_TRANSPORT_SSL=y

# --- Logging ---
CONFIG_LOG_DEFAULT_LEVEL_INFO=y
CONFIG_LOG_MAXIMUM_LEVEL_DEBUG=y

# --- Watchdog ---
CONFIG_ESP_TASK_WDT_TIMEOUT_S=10
CONFIG_ESP_TASK_WDT_CHECK_IDLE_TASK_CPU0=y
CONFIG_ESP_TASK_WDT_CHECK_IDLE_TASK_CPU1=y

# --- WebSockets ---
CONFIG_HTTPD_WS_SUPPORT=y
```
